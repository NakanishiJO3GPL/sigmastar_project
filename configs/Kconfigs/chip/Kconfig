## configs/verify/defconfigs/ipc_ifado.nor.uclibc-9.1.0-squashfs.ssc032b.64.qfn88_dualsnr_defconfig
```kconfig
CONFIG_ifado=y
CONFIG_BOARD="032B"
CONFIG_BOARD_NAME="SSC032B-S01A"
CONFIG_TOOLCHAIN_UCLIBC=y
CONFIG_TOOLCHAIN_REL_ARM-SIGMASTAR-LINUX-UCLIBCGNUEABIHF-9.1.0=y
CONFIG_BUSYBOX="busybox-1.20.2-arm-buildroot-linux-uclibcgnueabihf-uclibc-9.1.0-static"
CONFIG_UBOOT_CONFIG="ifado_defconfig"
CONFIG_UBOOT_BIN="u-boot.xz.img.bin"
CONFIG_DRAM_SIZE="0x4000000"
CONFIG_LX_MEM_SIZE="0x4000000"
CONFIG_MMA_MEM_SIZE="0x2000000"
CONFIG_CMA_MEM_SIZE="0x100000"
CONFIG_KERNEL_VERSION_5.10=y
CONFIG_KERNEL_CONFIG="ifado_ssc032b_s01a_dualsnr_defconfig"
CONFIG_KERNEL_BIN="uImage.xz"
CONFIG_IMAGE_CONFIG="nor.squashfs.partition.config"
CONFIG_IPL_CONFIG="IPL.ifado_nor.bin"
CONFIG_IPL_CUST_CONFIG="IPL_CUST.ifado_nor.bin"
CONFIG_FLASH_SIZE_16M=y
CONFIG_IQ0="imx307/imx307_iqfile.bin"
CONFIG_IQ1="imx307/imx307_iqfile.bin"
CONFIG_IQ2="imx307/imx307_iqfile.bin"
CONFIG_IQ3="imx307/imx307_iqfile.bin"
CONFIG_SENSOR_LIST="imx415_mipi.ko imx307_mipi.ko sc4336_mipi.ko gc4023_mipi.ko sc4336pd_mipi_dualsnr.ko"
CONFIG_SENSOR0="sc4336pd_mipi_dualsnr.ko"
CONFIG_SENSOR0_OPT="chmap=5"
CONFIG_CONFIG_ENABLE_MI_NORMAL_STR=y
CONFIG_DEBUG_SUPPORT=y
CONFIG_CUST_MODPARAM="modparam_2snr.json"
CONFIG_VERIFY_MI_DEMO=y
CONFIG_VERIFY_AMIGOS=y
CONFIG_VERIFY_SAMPLE_CODE=y
CONFIG_INTERFACE_IVE=y
# CONFIG_MI_RGN_SUPPORT_MOSAIC is not set
# CONFIG_MI_RGN_SUPPORT_COVER_MAP is not set
# CONFIG_MI_RGN_SUPPORT_COLOR_INVERT is not set
# CONFIG_MI_RGN_SUPPORT_BUF_CNT is not set
# CONFIG_INTERFACE_SED is not set
CONFIG_SENSOR_SUPPORT_PWM=y
# CONFIG_MI_SYS_META_POOL is not set
# CONFIG_INTERFACE_WLAN is not set
CONFIG_INTERFACE_DUMMY=y
```

## configs/verify/defconfigs/ipc_ifado.nor.uclibc-9.1.0-squashfs.ssc032b.64.qfn88_str_defconfig
```kconfig
CONFIG_ifado=y
CONFIG_BOARD="032B"
CONFIG_BOARD_NAME="SSC032B-S01A"
CONFIG_TOOLCHAIN_UCLIBC=y
CONFIG_TOOLCHAIN_REL_ARM-SIGMASTAR-LINUX-UCLIBCGNUEABIHF-9.1.0=y
CONFIG_BUSYBOX="busybox-1.20.2-arm-buildroot-linux-uclibcgnueabihf-uclibc-9.1.0-static"
CONFIG_UBOOT_CONFIG="ifado_defconfig"
CONFIG_UBOOT_BIN="u-boot.xz.img.bin"
CONFIG_DRAM_SIZE="0x4000000"
CONFIG_LX_MEM_SIZE="0x4000000"
CONFIG_MMA_MEM_SIZE="0x2000000"
CONFIG_CMA_MEM_SIZE="0x100000"
CONFIG_KERNEL_VERSION_5.10=y
CONFIG_KERNEL_CONFIG="ifado_ssc032b_s01a_str_defconfig"
CONFIG_KERNEL_BIN="uImage.xz"
CONFIG_IMAGE_CONFIG="nor.squashfs.partition.config"
CONFIG_IPL_CONFIG="IPL.ifado_nor_str.STR_PASSWORD_UART=y.PACKAGE_QFN88=y.QFN88=y.bin"
CONFIG_IPL_CUST_CONFIG="IPL_CUST.ifado_nor_str.STR_PASSWORD_UART=y.PACKAGE_QFN88=y.QFN88=y.bin"
CONFIG_FLASH_SIZE_16M=y
CONFIG_CONFIG_ENABLE_POWER_SAVE_AOV=y
CONFIG_DLA_FIRMWARE_LIST="ipu_net/det/spdy36.img"
CONFIG_IQ0="imx307/imx307_iqfile.bin"
CONFIG_IQ1="imx307/imx307_iqfile.bin"
CONFIG_IQ2="imx307/imx307_iqfile.bin"
CONFIG_IQ3="imx307/imx307_iqfile.bin"
CONFIG_IQ_API_LIST="sc4336P/sc4336P_api.bin sc4336P/sc4336P_night_api.bin"
CONFIG_SENSOR_LIST="imx415_mipi.ko sc4336p_mipi.ko"
CONFIG_SENSOR0="sc4336p_mipi.ko"
CONFIG_SENSOR0_OPT="chmap=1 mclk=27M sleep_mode=2"
CONFIG_CONFIG_ENABLE_MI_NORMAL_STR=y
CONFIG_DEBUG_SUPPORT=y
CONFIG_PACK_MOD_LIST="sstar_emac.ko"
CONFIG_VERIFY_MI_DEMO=y
CONFIG_VERIFY_SAMPLE_CODE=y
CONFIG_INTERFACE_IVE=y
# CONFIG_MI_RGN_SUPPORT_MOSAIC is not set
# CONFIG_MI_RGN_SUPPORT_COVER_MAP is not set
# CONFIG_MI_RGN_SUPPORT_COLOR_INVERT is not set
# CONFIG_MI_RGN_SUPPORT_BUF_CNT is not set
# CONFIG_INTERFACE_SED is not set
CONFIG_SENSOR_SUPPORT_PWM=y
# CONFIG_MI_SYS_META_POOL is not set
# CONFIG_INTERFACE_WLAN is not set
CONFIG_INTERFACE_DUMMY=y
```

## configs/verify/defconfigs/usbcam_ifado.spinand.uclibc-9.1.0-ubifs.ssc032a.128.qfn128_dualsnr_defconfig
```kconfig
CONFIG_ifado=y
CONFIG_USBCAM=y
CONFIG_BOARD="032A"
CONFIG_BOARD_NAME="SSC032A-S01A"
CONFIG_TOOLCHAIN_UCLIBC=y
CONFIG_TOOLCHAIN_REL_ARM-SIGMASTAR-LINUX-UCLIBCGNUEABIHF-9.1.0=y
CONFIG_BUSYBOX="busybox-1.20.2-arm-buildroot-linux-uclibcgnueabihf-uclibc-9.1.0-static"
CONFIG_UBOOT_CONFIG="ifado_spinand_defconfig"
CONFIG_UBOOT_BIN="u-boot.img.bin"
CONFIG_DRAM_SIZE="0x8000000"
CONFIG_LX_MEM_SIZE="0x8000000"
CONFIG_MMA_MEM_SIZE="0x4000000"
CONFIG_CMA_MEM_SIZE="0x200000"
CONFIG_KERNEL_VERSION_5.10=y
CONFIG_KERNEL_CONFIG="ifado_ssc032a_s01a_usbcam_spinand_dualsnr_defconfig"
CONFIG_KERNEL_BIN="uImage"
CONFIG_IMAGE_CONFIG="spinand.ubifs.partition.config"
CONFIG_IPL_CONFIG="IPL.ifado_nand.bin"
CONFIG_IPL_CUST_CONFIG="IPL_CUST.ifado_nand.bin"
CONFIG_FLASH_SIZE_16M=y
CONFIG_IQ0="imx307/imx307_iqfile.bin"
CONFIG_IQ1="imx307/imx307_iqfile.bin"
CONFIG_IQ2="imx307/imx307_iqfile.bin"
CONFIG_IQ3="imx307/imx307_iqfile.bin"
CONFIG_SENSOR_LIST="imx415_mipi.ko imx307_mipi.ko sc4336_mipi.ko gc4023_mipi.ko sc4336pd_mipi_dualsnr.ko"
CONFIG_SENSOR0="sc4336pd_mipi_dualsnr.ko"
CONFIG_SENSOR0_OPT="chmap=5"
CONFIG_CONFIG_ENABLE_MI_NORMAL_STR=y
CONFIG_DEBUG_SUPPORT=y
CONFIG_CUST_MODPARAM="modparam_2snr.json"
CONFIG_VERIFY_MI_DEMO=y
CONFIG_VERIFY_AMIGOS=y
CONFIG_VERIFY_SAMPLE_CODE=y
CONFIG_INTERFACE_IVE=y
# CONFIG_MI_RGN_SUPPORT_MOSAIC is not set
# CONFIG_MI_RGN_SUPPORT_COVER_MAP is not set
# CONFIG_MI_RGN_SUPPORT_COLOR_INVERT is not set
# CONFIG_MI_RGN_SUPPORT_BUF_CNT is not set
# CONFIG_INTERFACE_SED is not set
CONFIG_SENSOR_SUPPORT_PWM=y
# CONFIG_MI_SYS_META_POOL is not set
# CONFIG_INTERFACE_WLAN is not set
CONFIG_INTERFACE_DUMMY=y
```
