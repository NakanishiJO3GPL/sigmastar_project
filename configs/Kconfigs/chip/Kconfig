## configs/Kconfigs/chip/Kconfig
```kconfig
choice
    prompt "Chip"

    config Souffle
        bool "Souffle"

    config iford
        bool "iFord"

	config ifado
        bool "iFado"
endchoice

config CHIP
    string
    default "souffle" if Souffle
    default "iford" if iford
    default "ifado" if ifado
```

## configs/Kconfigs/sdk/interface/common/Kconfig
```kconfig
menuconfig INTERFACE_COMMON
    depends on SUPPORT_COMMON
    bool "common"
    default y
    help
        whether to compile or not

if INTERFACE_COMMON
config MI_COMMON_APITIME
    bool "apitime"
    default n
    help
        whether to compile or not

config mi_common_apitime
    string
    default enable if MI_COMMON_APITIME
    default disable if !MI_COMMON_APITIME

config mi_common_rgnsub
    string
    default enable if (INTERFACE_LDC || INTERFACE_VDISP)
    default disable if !(INTERFACE_LDC || INTERFACE_VDISP)
endif

config interface_common
    string
    default enable if INTERFACE_COMMON
    default disable if !INTERFACE_COMMON
```

## configs/Kconfigs/sdk/interface/sensor/Kconfig
```kconfig
menuconfig INTERFACE_SENSOR
    depends on SUPPORT_SENSOR
    bool "sensor"
    default y
    select INTERFACE_VIF
    help
        whether to compile or not

if INTERFACE_SENSOR

config MI_SENSOR_KAPI
    bool "KAPI"
    default n
    help
        whether to compile or not

config mi_sensor_kapi
    string
    default yes if MI_SENSOR_KAPI
    default no if !MI_SENSOR_KAPI

config config_mi_sensor
    bool "mi_sensor"
    default y
    help
        whether to compile or not

config SENSOR_SUPPORT_PWM
    bool "sensor support PWM"
    default n
    help
        whether sensor support pwm control

endif
config interface_sensor
    string
    default enable if INTERFACE_SENSOR
    default disable if !INTERFACE_SENSOR
```

## configs/Kconfigs/sdk/interface/vdec/Kconfig
```kconfig
menuconfig INTERFACE_VDEC
    depends on SUPPORT_VDEC
    bool "vdec"
    default y
    help
        whether to compile or not

if INTERFACE_VDEC

config MI_VDEC_KAPI
    bool "KAPI"
    default n
    help
        whether to compile or not

config mi_vdec_kapi
    string
    default yes if MI_VDEC_KAPI
    default no if !MI_VDEC_KAPI

endif

config interface_vdec
    string
    default enable if INTERFACE_VDEC
    default disable if !INTERFACE_VDEC
```

## configs/Kconfigs/sdk/verify/amigos/Kconfig
```kconfig
config VERIFY_AMIGOS
    bool "amigos"
    default n
    help
        whether to compile or not

config verify_amigos
    string
    default enable if VERIFY_AMIGOS
    default disable if !VERIFY_AMIGOS
```

## configs/Kconfigs/sdk/verify/ptree/Kconfig
```kconfig
config VERIFY_PTREE
    bool "pipeline_tree"
    default n
    help
        whether to compile or not

config verify_ptree
    string
    default enable if VERIFY_PTREE
    default disable if !VERIFY_PTREE
```

## configs/Kconfigs/sdk/verify/sample_code/Kconfig
```kconfig
config VERIFY_SAMPLE_CODE
    bool "sample_code"
    default n
    help
        whether to compile or not

config verify_sample_code
    string
    default enable if VERIFY_SAMPLE_CODE
    default disable if !VERIFY_SAMPLE_CODE
```

## configs/demo/defconfigs/ipc-rtos_ifado.nor.uclibc-9.1.0-ramdisk.ssc032a.128.qfn128_dualsnr_rt_aov_defconfig
```kconfig
CONFIG_ifado=y
CONFIG_BOARD="032A"
CONFIG_BOARD_NAME="SSC032A-S01A"
CONFIG_TOOLCHAIN_UCLIBC=y
CONFIG_TOOLCHAIN_REL_ARM-SIGMASTAR-LINUX-UCLIBCGNUEABIHF-9.1.0=y
CONFIG_BUSYBOX="busybox-1.20.2-arm-buildroot-linux-uclibcgnueabihf-uclibc-9.1.0-static"
CONFIG_UBOOT_CONFIG="ifado_lh_defconfig"
CONFIG_UBOOT_BIN="u-boot.lz4.img.bin"
CONFIG_DRAM_SIZE="0x8000000"
CONFIG_LX_MEM_SIZE="0x3000000"
CONFIG_CMA_MEM_SIZE="0x200000"
CONFIG_RTOS_MEM_SIZE="0xA00000"
CONFIG_RTOS_TIMESTAMP_MEM_SIZE="0x1000"
CONFIG_RTOS_RAMDISK_MEM_SIZE="0x0"
CONFIG_EARLYINIT_MEM_SIZE="0x100000"
CONFIG_KERNEL_VERSION_5.10=y
CONFIG_KERNEL_CONFIG="ifado_ssc032a_s01a_lh_aov_dualsnr_defconfig"
CONFIG_KERNEL_BIN="uImage.lz4"
CONFIG_IMAGE_CONFIG="nor-ramdisk.rofiles.rtos.partition.config"
CONFIG_IPL_CONFIG="IPL.ifado_nor_dualos_aov.STR_PASSWORD_UART=y.PACKAGE_QFN128=y.QFN128=y.bin"
CONFIG_IPL_CUST_CONFIG="IPL_CUST.ifado_nor_dualos_aov.STR_PASSWORD_UART=y.PACKAGE_QFN128=y.QFN128=y.lz4"
CONFIG_FLASH_SIZE_16M=y
CONFIG_CONFIG_ENABLE_POWER_SAVE_AOV=y
CONFIG_DLA_FIRMWARE_LIST="ipu_net/det/spdy36.img"
CONFIG_IQ0="imx307/imx307_iqfile.bin"
CONFIG_IQ1="imx307/imx307_iqfile.bin"
CONFIG_IQ2="imx307/imx307_iqfile.bin"
CONFIG_IQ3="imx307/imx307_iqfile.bin"
CONFIG_IQ_API_LIST="sc4336P/sc4336P_api.bin sc4336P/sc4336P_night_api.bin"
CONFIG_SENSOR_LIST="sc4336pdualsnraov_mipi.ko"
CONFIG_SENSOR0="sc4336pdualsnraov_mipi.ko"
CONFIG_SENSOR0_OPT="chmap=5 mclk=27M sleep_mode=2"
CONFIG_CONFIG_ENABLE_MI_NORMAL_STR=y
CONFIG_DEBUG_SUPPORT=y
CONFIG_BOOL_RTOS_ENABLE=y
CONFIG_RTOS_BIN="rtos.lz4"
CONFIG_RTOS_CONFIG="ifado_ssc032a_s01a_128_ipc_lh_nor_dualsnr_defconfig"
CONFIG_CONFIG_MI_SDK_SUPPORT=y
CONFIG_CONFIG_SENSOR_DRIVER_SUPPORT=y
CONFIG_CONFIG_SENSOR_EARLYINIT_SUPPORT=y
CONFIG_CONFIG_EARLYINIT_SETTING_JSON="dual_sensor_realtime_preload_sample.json"
CONFIG_CONFIG_EARLYINIT_SETTING_FS=y
CONFIG_CONFIG_SENSOR_EARLYINIT_ENABLE=0x05
CONFIG_CONFIG_EARLYINIT_SENSOR_LIGHTSENSOR_SUPPORT=y
CONFIG_CONFIG_APPLICATION_AOV=y
CONFIG_CONFIG_ENABLE_MI_SDK_PIPELINE_FLOW=y
CONFIG_CONFIG_CUS3A_SUPPORT=y
CONFIG_CONFIG_CUST_ISP_SUPPORT=y
CONFIG_CUST_MODPARAM="modparam_aov_2snr_rt.json"
CONFIG_SENSOR_TYPE="sc4336P"
CONFIG_SENSOR_TYPE2="sc4336P"
CONFIG_PRELOAD_FILE="PreloadSettingForDualSensor.txt"
CONFIG_VERIFY_MI_DEMO=y
CONFIG_VERIFY_SAMPLE_CODE=y
CONFIG_INTERFACE_IVE=y
# CONFIG_MI_RGN_SUPPORT_MOSAIC is not set
# CONFIG_MI_RGN_SUPPORT_COVER_MAP is not set
# CONFIG_MI_RGN_SUPPORT_COLOR_INVERT is not set
# CONFIG_MI_RGN_SUPPORT_BUF_CNT is not set
# CONFIG_INTERFACE_SED is not set
CONFIG_SENSOR_SUPPORT_PWM=y
# CONFIG_MI_SYS_META_POOL is not set
# CONFIG_INTERFACE_WLAN is not set
CONFIG_INTERFACE_DUMMY=y
```

## configs/demo/defconfigs/ipc-rtos_ifado.nor.uclibc-9.1.0-ramdisk.ssc032b.64.qfn88_dualsnr_defconfig
```kconfig
CONFIG_ifado=y
CONFIG_IPC-RTOS=y
CONFIG_BOARD="032B"
CONFIG_BOARD_NAME="SSC032B-S01A"
CONFIG_TOOLCHAIN_UCLIBC=y
CONFIG_TOOLCHAIN_REL_ARM-SIGMASTAR-LINUX-UCLIBCGNUEABIHF-9.1.0=y
CONFIG_BUSYBOX="busybox-1.20.2-arm-buildroot-linux-uclibcgnueabihf-uclibc-9.1.0-static"
CONFIG_UBOOT_CONFIG="ifado_lh_64MB_defconfig"
CONFIG_UBOOT_BIN="u-boot.lz4.img.bin"
CONFIG_DRAM_SIZE="0x4000000"
CONFIG_LX_MEM_SIZE="0x1900000"
CONFIG_CMA_MEM_SIZE="0x200000"
CONFIG_RTOS_MEM_SIZE="0x600000"
CONFIG_RTOS_TIMESTAMP_MEM_SIZE="0x1000"
CONFIG_RTOS_RAMDISK_MEM_SIZE="0x0"
CONFIG_EARLYINIT_MEM_SIZE="0x200000"
CONFIG_KERNEL_VERSION_5.10=y
CONFIG_KERNEL_CONFIG="ifado_ssc032b_s01a_lh_defconfig"
CONFIG_KERNEL_BIN="uImage.lz4"
CONFIG_IMAGE_CONFIG="nor-ramdisk.rofiles.rtos.partition.config"
CONFIG_IPL_CONFIG="IPL.ifado_nor_dualos_64MB.bin"
CONFIG_IPL_CUST_CONFIG="IPL_CUST.ifado_nor_dualos_64MB.lz4"
CONFIG_FLASH_SIZE_16M=y
CONFIG_DLA_FIRMWARE_LIST="ipu_net/det/spdy48.img"
CONFIG_IQ0="imx307/imx307_iqfile.bin"
CONFIG_IQ1="imx307/imx307_iqfile.bin"
CONFIG_IQ2="imx307/imx307_iqfile.bin"
CONFIG_IQ3="imx307/imx307_iqfile.bin"
CONFIG_SENSOR_LIST="sc4336pd_mipi_dualsnr.ko"
CONFIG_SENSOR0="sc4336pd_mipi_dualsnr.ko"
CONFIG_SENSOR0_OPT="chmap=5"
CONFIG_DEBUG_SUPPORT=y
# CONFIG_ENABLE_ECHO_CMD is not set
CONFIG_CUST_MODPARAM="modparam_2snr.json"
CONFIG_BOOL_RTOS_ENABLE=y
CONFIG_RTOS_BIN="rtos.lz4"
CONFIG_RTOS_CONFIG="ifado_ssc032b_s01a_64_ipc_lh_nor_dualsnr_defconfig"
CONFIG_CONFIG_MI_SDK_SUPPORT=y
CONFIG_CONFIG_SENSOR_DRIVER_SUPPORT=y
CONFIG_CONFIG_SENSOR_EARLYINIT_SUPPORT=y
CONFIG_CONFIG_EARLYINIT_SETTING_JSON="dual_sensor_realtime.json"
CONFIG_CONFIG_EARLYINIT_SETTING_FS=y
CONFIG_CONFIG_SENSOR_EARLYINIT_ENABLE=0x05
CONFIG_CONFIG_ENABLE_MI_SDK_PIPELINE_FLOW=y
CONFIG_CONFIG_CUS3A_SUPPORT=y
CONFIG_CONFIG_CUST_ISP_SUPPORT=y
CONFIG_SENSOR_TYPE="imx415"
CONFIG_SENSOR_TYPE2="imx415"
CONFIG_PRELOAD_FILE="PreloadSettingForDualSensor.txt"
CONFIG_VERIFY_MI_DEMO=y
CONFIG_VERIFY_AMIGOS=y
CONFIG_VERIFY_SAMPLE_CODE=y
CONFIG_MI_DBG_MINIMAL=y
# CONFIG_ENABLE_MI_LOG_FUNCTION is not set
# CONFIG_ENABLE_MI_LOG_FILE is not set
# CONFIG_INTERFACE_AIO is not set
# CONFIG_INTERFACE_AI is not set
# CONFIG_INTERFACE_AO is not set
CONFIG_INTERFACE_IVE=y
# CONFIG_MI_RGN_SUPPORT_MOSAIC is not set
# CONFIG_MI_RGN_SUPPORT_COVER_MAP is not set
# CONFIG_MI_RGN_SUPPORT_COLOR_INVERT is not set
# CONFIG_MI_RGN_SUPPORT_BUF_CNT is not set
# CONFIG_INTERFACE_SED is not set
CONFIG_SENSOR_SUPPORT_PWM=y
# CONFIG_MI_SYS_META_POOL is not set
# CONFIG_INTERFACE_VDISP is not set
# CONFIG_INTERFACE_WLAN is not set
```

## configs/verify/defconfigs/ipc-rtos_ifado.nor.uclibc-9.1.0-ramdisk.ssc032b.64.qfn88_defconfig
```kconfig
CONFIG_ifado=y
CONFIG_IPC-RTOS=y
CONFIG_BOARD="032B"
CONFIG_BOARD_NAME="SSC032B-S01A"
CONFIG_TOOLCHAIN_UCLIBC=y
CONFIG_TOOLCHAIN_REL_ARM-SIGMASTAR-LINUX-UCLIBCGNUEABIHF-9.1.0=y
CONFIG_BUSYBOX="busybox-1.20.2-arm-buildroot-linux-uclibcgnueabihf-uclibc-9.1.0-static"
CONFIG_UBOOT_CONFIG="ifado_lh_64MB_defconfig"
CONFIG_UBOOT_BIN="u-boot.lz4.img.bin"
CONFIG_DRAM_SIZE="0x4000000"
CONFIG_LX_MEM_SIZE="0x1900000"
CONFIG_CMA_MEM_SIZE="0x200000"
CONFIG_RTOS_MEM_SIZE="0x600000"
CONFIG_RTOS_TIMESTAMP_MEM_SIZE="0x1000"
CONFIG_RTOS_RAMDISK_MEM_SIZE="0x0"
CONFIG_EARLYINIT_MEM_SIZE="0x100000"
CONFIG_KERNEL_VERSION_5.10=y
CONFIG_KERNEL_CONFIG="ifado_ssc032b_s01a_lh_defconfig"
CONFIG_KERNEL_BIN="uImage.lz4"
CONFIG_IMAGE_CONFIG="nor-ramdisk.rofiles.rtos.partition.config"
CONFIG_IPL_CONFIG="IPL.ifado_nor_dualos_64MB.bin"
CONFIG_IPL_CUST_CONFIG="IPL_CUST.ifado_nor_dualos_64MB.lz4"
CONFIG_FLASH_SIZE_16M=y
CONFIG_DLA_FIRMWARE_LIST="ipu_net/det/spdy48.img"
CONFIG_IQ0="imx307/imx307_iqfile.bin"
CONFIG_IQ1="imx307/imx307_iqfile.bin"
CONFIG_IQ2="imx307/imx307_iqfile.bin"
CONFIG_IQ3="imx307/imx307_iqfile.bin"
CONFIG_SENSOR_LIST="imx415_mipi.ko"
CONFIG_SENSOR0="imx415_mipi.ko"
CONFIG_SENSOR0_OPT="chmap=1"
CONFIG_CONFIG_ENABLE_MI_NORMAL_STR=y
CONFIG_DEBUG_SUPPORT=y
CONFIG_BOOL_RTOS_ENABLE=y
CONFIG_RTOS_BIN="rtos.lz4"
CONFIG_RTOS_CONFIG="ifado_ssc032b_s01a_64_ipc_lh_nor_defconfig"
CONFIG_CONFIG_MI_SDK_SUPPORT=y
CONFIG_CONFIG_SENSOR_DRIVER_SUPPORT=y
CONFIG_CONFIG_SENSOR_EARLYINIT_SUPPORT=y
CONFIG_CONFIG_EARLYINIT_SETTING_FS=y
CONFIG_CONFIG_ENABLE_MI_SDK_PIPELINE_FLOW=y
CONFIG_CONFIG_CUS3A_SUPPORT=y
CONFIG_CONFIG_CUST_ISP_SUPPORT=y
CONFIG_CONFIG_APPLICATION_SAMPLE=y
CONFIG_SENSOR_TYPE="imx415"
CONFIG_VERIFY_MI_DEMO=y
CONFIG_VERIFY_AMIGOS=y
CONFIG_VERIFY_SAMPLE_CODE=y
CONFIG_INTERFACE_IVE=y
# CONFIG_MI_RGN_SUPPORT_MOSAIC is not set
# CONFIG_MI_RGN_SUPPORT_COVER_MAP is not set
# CONFIG_MI_RGN_SUPPORT_COLOR_INVERT is not set
# CONFIG_MI_RGN_SUPPORT_BUF_CNT is not set
# CONFIG_INTERFACE_SED is not set
# CONFIG_MI_SYS_META_POOL is not set
# CONFIG_INTERFACE_WLAN is not set
CONFIG_INTERFACE_DUMMY=y
```

## configs/verify/defconfigs/ipc-rtos_ifado.spinand.glibc-11.1.0-ramdisk.ssc032a.128.qfn128_dualsnr_defconfig
```kconfig
CONFIG_ifado=y
CONFIG_IPC-RTOS=y
CONFIG_BOARD="032A"
CONFIG_BOARD_NAME="SSC032A-S01A"
CONFIG_TOOLCHAIN_VERSION_11.1.0=y
CONFIG_TOOLCHAIN_REL_ARM-LINUX-GNUEABIHF-SIGMASTAR-11.1.0=y
CONFIG_BUSYBOX="busybox-1.20.2-arm-linux-gnueabihf-glibc-sigmastar-11.1.0-dynamic"
CONFIG_UBOOT_CONFIG="ifado_lh_spinand_defconfig"
CONFIG_UBOOT_BIN="u-boot.lz4.img.bin"
CONFIG_DRAM_SIZE="0x8000000"
CONFIG_LX_MEM_SIZE="0x3000000"
CONFIG_CMA_MEM_SIZE="0x200000"
CONFIG_RTOS_MEM_SIZE="0xA00000"
CONFIG_RTOS_TIMESTAMP_MEM_SIZE="0x1000"
CONFIG_RTOS_RAMDISK_MEM_SIZE="0x0"
CONFIG_EARLYINIT_MEM_SIZE="0x100000"
CONFIG_KERNEL_VERSION_5.10=y
CONFIG_KERNEL_CONFIG="ifado_ssc032a_s01a_lh_spinand_defconfig"
CONFIG_KERNEL_BIN="uImage.lz4"
CONFIG_IMAGE_CONFIG="spinand-ramdisk.rofiles.rtos.partition.config"
CONFIG_IPL_CONFIG="IPL.ifado_nand_dualos.bin"
CONFIG_IPL_CUST_CONFIG="IPL_CUST.ifado_nand_dualos.lz4"
CONFIG_FLASH_SIZE_16M=y
CONFIG_DLA_FIRMWARE_LIST="ipu_net/det/spdy48.img"
CONFIG_IQ0="imx307/imx307_iqfile.bin"
CONFIG_IQ1="imx307/imx307_iqfile.bin"
CONFIG_IQ2="imx307/imx307_iqfile.bin"
CONFIG_IQ3="imx307/imx307_iqfile.bin"
CONFIG_SENSOR_LIST="imx415_mipi.ko"
CONFIG_SENSOR0="imx415_mipi.ko"
CONFIG_SENSOR0_OPT="chmap=5"
CONFIG_CONFIG_ENABLE_MI_NORMAL_STR=y
CONFIG_DEBUG_SUPPORT=y
CONFIG_BOOL_RTOS_ENABLE=y
CONFIG_RTOS_BIN="rtos.lz4"
CONFIG_RTOS_CONFIG="ifado_ssc032a_s01a_128_ipc_lh_spinand_dualsnr_defconfig"
CONFIG_CONFIG_MI_SDK_SUPPORT=y
CONFIG_CONFIG_SENSOR_DRIVER_SUPPORT=y
CONFIG_CONFIG_SENSOR_EARLYINIT_SUPPORT=y
CONFIG_CONFIG_EARLYINIT_SETTING_JSON="dual_sensor_frame.json"
CONFIG_CONFIG_EARLYINIT_SETTING_FS=y
CONFIG_CONFIG_SENSOR_EARLYINIT_ENABLE=0x05
CONFIG_CONFIG_ENABLE_MI_SDK_PIPELINE_FLOW=y
CONFIG_CONFIG_PIPELINE_TREE=y
CONFIG_CONFIG_PIPELINE_TREE_FILE="2snr_frame_2m24p_2m24p_ipu_vdf_ptree.json"
CONFIG_CONFIG_CUS3A_SUPPORT=y
CONFIG_CONFIG_CUST_ISP_SUPPORT=y
CONFIG_SENSOR_TYPE="imx415"
CONFIG_SENSOR_TYPE2="imx415"
CONFIG_PRELOAD_FILE="PreloadSettingForDualSensor.txt"
CONFIG_VERIFY_MI_DEMO=y
CONFIG_VERIFY_AMIGOS=y
CONFIG_VERIFY_SAMPLE_CODE=y
CONFIG_INTERFACE_IVE=y
# CONFIG_MI_RGN_SUPPORT_MOSAIC is not set
# CONFIG_MI_RGN_SUPPORT_COVER_MAP is not set
# CONFIG_MI_RGN_SUPPORT_COLOR_INVERT is not set
# CONFIG_MI_RGN_SUPPORT_BUF_CNT is not set
# CONFIG_INTERFACE_SED is not set
# CONFIG_MI_SYS_META_POOL is not set
# CONFIG_INTERFACE_WLAN is not set
CONFIG_INTERFACE_DUMMY=y
```

## configs/verify/defconfigs/ipc_ifado.nor.glibc-11.1.0-squashfs.ssc032b.64.qfn88_defconfig
```kconfig
CONFIG_ifado=y
CONFIG_BOARD="032B"
CONFIG_BOARD_NAME="SSC032B-S01A"
CONFIG_TOOLCHAIN_VERSION_11.1.0=y
CONFIG_TOOLCHAIN_REL_ARM-LINUX-GNUEABIHF-SIGMASTAR-11.1.0=y
CONFIG_BUSYBOX="busybox-1.20.2-arm-linux-gnueabihf-glibc-sigmastar-11.1.0-dynamic"
CONFIG_UBOOT_CONFIG="ifado_defconfig"
CONFIG_UBOOT_BIN="u-boot.xz.img.bin"
CONFIG_DRAM_SIZE="0x4000000"
CONFIG_LX_MEM_SIZE="0x4000000"
CONFIG_MMA_MEM_SIZE="0x2000000"
CONFIG_CMA_MEM_SIZE="0x100000"
CONFIG_KERNEL_VERSION_5.10=y
CONFIG_KERNEL_CONFIG="ifado_ssc032b_s01a_defconfig"
CONFIG_KERNEL_BIN="uImage.xz"
CONFIG_IMAGE_CONFIG="nor.squashfs.partition.config"
CONFIG_IPL_CONFIG="IPL.ifado_nor.bin"
CONFIG_IPL_CUST_CONFIG="IPL_CUST.ifado_nor.bin"
CONFIG_FLASH_SIZE_16M=y
CONFIG_IQ0="imx307/imx307_iqfile.bin"
CONFIG_IQ1="imx307/imx307_iqfile.bin"
CONFIG_IQ2="imx307/imx307_iqfile.bin"
CONFIG_IQ3="imx307/imx307_iqfile.bin"
CONFIG_SENSOR_LIST="imx415_mipi.ko imx307_mipi.ko sc4336_mipi.ko gc4023_mipi.ko"
CONFIG_SENSOR0="imx415_mipi.ko"
CONFIG_SENSOR0_OPT="chmap=5"
CONFIG_CONFIG_ENABLE_MI_NORMAL_STR=y
CONFIG_DEBUG_SUPPORT=y
CONFIG_VERIFY_MI_DEMO=y
CONFIG_VERIFY_AMIGOS=y
CONFIG_VERIFY_SAMPLE_CODE=y
CONFIG_INTERFACE_IVE=y
# CONFIG_MI_RGN_SUPPORT_MOSAIC is not set
# CONFIG_MI_RGN_SUPPORT_COVER_MAP is not set
# CONFIG_MI_RGN_SUPPORT_COLOR_INVERT is not set
# CONFIG_MI_RGN_SUPPORT_BUF_CNT is not set
# CONFIG_INTERFACE_SED is not set
CONFIG_SENSOR_SUPPORT_PWM=y
# CONFIG_MI_SYS_META_POOL is not set
# CONFIG_INTERFACE_WLAN is not set
CONFIG_INTERFACE_DUMMY=y
```
